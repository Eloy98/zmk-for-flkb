## config/boards/arm/flkb/Kconfig.board
```kconfig
#
# Copyright (c) 2023 Deemen17
# SPDX-License-Identifier: MIT
#
config BOARD_FLKB_LEFT
	bool "FLKB_left"
	depends on SOC_NRF52840_QIAA

config BOARD_FLKB_RIGHT
	bool "FLKB_right"
	depends on SOC_NRF52840_QIAA
```

## config/boards/arm/flkb/Kconfig.defconfig
```kconfig
#
# Copyright (c) 2023 Deemen17
# SPDX-License-Identifier: MIT
#

if BOARD_FLKB_LEFT

config ZMK_KEYBOARD_NAME
	default "FLKB"

config ZMK_SPLIT
	default y

config ZMK_SPLIT_BLE_ROLE_CENTRAL
	default y

endif # BOARD_FLKB_DONGLE

if BOARD_FLKB_LEFT || BOARD_FLKB_RIGHT

config BOARD
	default "FLKB"

config I2C
	bool
	default y

config SPI
    bool
    default y

endif # BOARD_FLKB_LEFT || BOARD_FLKB_RIGHT

if BOARD_FLKB_LEFT || BOARD_FLKB_RIGHT

config ZMK_SPLIT
	default y

if USB

config USB_DEVICE_STACK
	default y

if USB_DEVICE_STACK

config USB_NRFX
	default y

endif # USB_DEVICE_STACK

endif # USB

config BT_CTLR
	default BT

endif # BOARD_FLKB_LEFT || BOARD_FLKB_RIGHT
```
